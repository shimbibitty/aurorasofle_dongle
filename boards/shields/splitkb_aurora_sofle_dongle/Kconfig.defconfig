## boards/shields/splitkb_aurora_sofle_dongle/Kconfig.defconfig
```kconfig
if SHIELD_SPLITKB_AURORA_SOFLE_DONGLE

config ZMK_KEYBOARD_NAME
    default "Sofle Dongle"

config ZMK_SPLIT_ROLE_CENTRAL
    default y
	
endif



if SHIELD_SPLITKB_AURORA_SOFLE_DONGLE || SHIELD_SPLITKB_AURORA_SOFLE_LEFT || SHIELD_SPLITKB_AURORA_SOFLE_RIGHT

config ZMK_SPLIT
    default y
	
config ZMK_BATTERY_REPORTING
	default y
	
config ZMK_BATTERY_REPORT_INTERVAL
	default 30

if ZMK_DISPLAY

config I2C
    default y

config SSD1306
    default y

choice ZMK_DISPLAY_WORK_QUEUE
    default ZMK_DISPLAY_WORK_QUEUE_DEDICATED
endchoice

endif

if SSD1306

config LV_Z_VDB_SIZE
    default 64

config LV_DPI_DEF
    default 148

config LV_Z_BITS_PER_PIXEL
    default 1

choice LV_COLOR_DEPTH
    default LV_COLOR_DEPTH_1
endchoice

endif

endif
```
